## linux-project/yocto-project/build-pi/conf/bblayers.conf
```bitbake
# POKY_BBLAYERS_CONF_VERSION is increased each time build/conf/bblayers.conf
# changes incompatibly
POKY_BBLAYERS_CONF_VERSION = "2"

BBPATH = "${TOPDIR}"
BBFILES ?= ""

BBLAYERS ?= " \
  /home/zach/Documents/Projects/solid-state-anemometer/linux-project/yocto-project/poky/meta \
  /home/zach/Documents/Projects/solid-state-anemometer/linux-project/yocto-project/poky/meta-poky \
  /home/zach/Documents/Projects/solid-state-anemometer/linux-project/yocto-project/poky/meta-yocto-bsp \
  /home/zach/Documents/Projects/solid-state-anemometer/linux-project/yocto-project/meta-openembedded/meta-oe \
  /home/zach/Documents/Projects/solid-state-anemometer/linux-project/yocto-project/meta-openembedded/meta-python \
  /home/zach/Documents/Projects/solid-state-anemometer/linux-project/yocto-project/meta-openembedded/meta-networking \
  /home/zach/Documents/Projects/solid-state-anemometer/linux-project/yocto-project/meta-openembedded/meta-multimedia \
  /home/zach/Documents/Projects/solid-state-anemometer/linux-project/yocto-project/meta-raspberrypi \
  /home/zach/Documents/Projects/solid-state-anemometer/linux-project/yocto-project/meta-anemometer \
  "
```
